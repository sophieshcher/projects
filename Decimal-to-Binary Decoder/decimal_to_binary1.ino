#include <LiquidCrystal.h>
LiquidCrystal lcd(7, 8, 9, 10, 11, 12);
//оголошення піна для кнопки 0, як константи
const int but0 = 2;
//оголошення піна для кнопки 1
const int but1 = 3;
//оголошення піна для зеленої лед лампочки
const int ledGreen = 6;
//оголошення піна для червоної лед лампочки, як константи
const int ledRed = 5;
//оголошення змінної для збереження десяткового числа
int decNumber;
//оголошення масиву із 8-ма елементами(правильне двійкове число)
int correctBits[8];
//оголошення масиву із 8-ма елементами(введене користувачем двійкове число)
int usersBits[8];
//це позиція на яку записуватиметься 1 чи 0 в двійкове число
int bitCount = 0;

void setup() {
  lcd.begin(16, 2);  //викликається lcd модуль 
  pinMode(but0, INPUT); // пін кнопки 0 буде читати вхідного сигнал
  pinMode(but1, INPUT); // пін кнопки 1 буде читати вхідного сигнал
  pinMode(ledGreen, OUTPUT); // а тут з піна буде подаватись сигнал на зелен лед лампочку  
  pinMode(ledRed, OUTPUT); // теж сигнал подається на червону лед лампочку
  randomSeed(analogRead(A0)); // ініціалізується генератор випадкових чисел на основі шумів із непідключеного піна
  decNumber = random(0, 256); // рандомне число в діапазоні від 0 до 255
  lcd.setCursor(0, 0); // ставимо курсор в лівий верхній кут екрана
  lcd.print("Generated: "); // підпис "Generated: " і тут буде записуватись рандомне згенероване число
  lcd.print(decNumber); // тут воно саме виводиться
  lcd.setCursor(0, 1); // переводиться курсор на рядок нижче
  lcd.print("Pass: "); // підпис "Pass: " і тут буде виводитись число користувача
  int num = decNumber; // змінна для маніпуляцій над десятковим згенерованим числом
  for (int i=7; i>=0; i-- ){ //проходимось циклом щоб записати на кожну з 8 позицій двійкового числа
  	correctBits[i] = num % 2; //на кожному кроці ділимо з остачею, і вона ж записується(1 чи 0)
    num /= 2; // зменшуємо число яке преводимо в двійкову систему вдвічі і цикл повторюється доки не заповняться всі 8 позицій
  }
}

void loop(){
  int but0state = digitalRead(but0); // стан кнопки: натиснута чи ні
  int but1state = digitalRead(but1); // стан кнопки: натиснута чи ні
  delay(50);// затримка для стабільності зчитування сигналу з кнопок
  if(but0state == HIGH ){// первіряємо чи натиснута кнопку 0
    if(bitCount < 8){//чи всі вісім бітів введене
      usersBits[bitCount] = 0; // в масиві числа, яке записує користувач, записується 0
      lcd.setCursor(6 + bitCount, 1); //курсор переводится на 6 символів від початку щоб не стерти напис
      lcd.print("0"); //друкується на екранчик "0"
      bitCount++; //збільшується лічильник введених бітів
    }
    while(digitalRead(but0) == HIGH); //виконується пустий рядок поки кнопка натиснута, щоб за одне натискання і справді вводилась одна цифра
  }
  if(but1state == HIGH){// первірка чи натиснута кнопка 1
    if(bitCount < 8){//чи всі вісім бітів введене
      usersBits[bitCount] = 1; // в масиві числа, яке записує користувач, записується 0
      lcd.setCursor(6 + bitCount, 1);//курсор переводится на 6 символів від початку щоб не стерти напис
      lcd.print("1"); //друкується на екранчик "1"
      bitCount++; //збільшується лічильник введених бітів
    }
    while(digitalRead(but1) == HIGH); //виконується пустий рядок поки кнопка натиснута
   }
  if (bitCount == 8){ //перевіряємо чи введення числа завершилось
    bool correct = true; //створюємо змінну бул
    for (int i =0; i<8; i++){ //циклом проходимось по кожній позиції числа
      if(usersBits[i] != correctBits[i]){ //перевіряємо на помилку чи якийсь введенний користувачем із не співпадає із правильним
        correct = false; //якщо це так в змінну записуємо false
        break; //і перериваємо цикл
      }
    }
    if(correct == false) { //тут перевірка на помилку
      digitalWrite(ledRed, HIGH); //і вмикається червона лампочка
      digitalWrite(ledGreen, LOW); //зелена повинна бути вимкненою
    }else{
      digitalWrite(ledGreen, HIGH); //і навпаки вмикається зелена
      digitalWrite(ledRed, LOW); //червона вимкнена
    }
    while(true); //програма зупиняється в такому стані із ввімкненою лампочкою та із написаним числом 
  }
}


